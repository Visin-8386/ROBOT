## SIN/sdkconfig.defaults
```kconfig
CONFIG_ESP_BROWNOUT_DET=n
CONFIG_SPIRAM=n
CONFIG_ESP_DEFAULT_CPU_FREQ_MHZ_80=y
CONFIG_ESPTOOLPY_FLASHMODE_DIO=y
CONFIG_ESPTOOLPY_FLASHFREQ_40M=y
```

## station/sdkconfig.defaults
```kconfig
# ESP32-CAM OV3660 Stream — sdkconfig.defaults
# Target: ESP32 (AI-Thinker board with PSRAM)

# --- PSRAM ---
CONFIG_ESP32_SPIRAM_SUPPORT=y
CONFIG_SPIRAM=y
CONFIG_SPIRAM_ALLOW_STACK_EXTERNAL_MEMORY=y
CONFIG_SPIRAM_USE_MALLOC=y
CONFIG_SPIRAM_MALLOC_ALWAYSINTERNAL=4096
CONFIG_SPIRAM_MALLOC_ALWAYSINTERNAL=4096
# CONFIG_SPIRAM_TRY_ALLOCATE_WIFI_LWIP is not set
CONFIG_SPIRAM_MALLOC_RESERVE_INTERNAL=32768

# --- Camera ---
CONFIG_OV3660_SUPPORT=y
CONFIG_CAMERA_TASK_STACK_SIZE=4096

# --- WiFi ---
CONFIG_ESP_WIFI_SSID="Thuy Duong"
CONFIG_ESP_WIFI_PASSWORD="thang1972"

# Disable WiFi power save — eliminates 100ms+ latency spikes
CONFIG_ESP_WIFI_SLP_IRAM_OPT=n
CONFIG_PM_ENABLE=n

# --- LwIP TCP — Optimized for 32KB internal RAM buffers ---
CONFIG_LWIP_TCP_SND_BUF_DEFAULT=32768
CONFIG_LWIP_TCP_WND_DEFAULT=32768
CONFIG_LWIP_TCP_RECVMBOX_SIZE=32
CONFIG_LWIP_TCP_MSS=1440
CONFIG_LWIP_TCP_OVERSIZE_MSS=y

# --- WiFi Throughput Optimization ---
CONFIG_ESP_WIFI_STATIC_RX_BUFFER_NUM=16
CONFIG_ESP_WIFI_DYNAMIC_RX_BUFFER_NUM=64
CONFIG_ESP_WIFI_DYNAMIC_TX_BUFFER_NUM=64
CONFIG_ESP_WIFI_AMPDU_TX_ENABLED=y
CONFIG_ESP_WIFI_AMPDU_RX_ENABLED=y
CONFIG_ESP_WIFI_RX_BA_WIN=16

# --- HTTP Server ---
CONFIG_HTTPD_MAX_REQ_HDR_LEN=1024
CONFIG_HTTPD_MAX_URI_LEN=512

# --- Partition Table (2MB app) ---
CONFIG_PARTITION_TABLE_CUSTOM=y
CONFIG_PARTITION_TABLE_CUSTOM_FILENAME="partitions.csv"

# --- Flash ---
CONFIG_ESPTOOLPY_FLASHSIZE_4MB=y
CONFIG_ESPTOOLPY_FLASHFREQ_80M=y
CONFIG_ESPTOOLPY_FLASHMODE_QIO=y

# --- FreeRTOS ---
CONFIG_FREERTOS_HZ=1000

# --- CPU Frequency ---
CONFIG_ESP32_DEFAULT_CPU_FREQ_240=y
CONFIG_ESP32_DEFAULT_CPU_FREQ_MHZ=240

# --- Task Watchdog — tăng timeout cho camera init chậm ---
CONFIG_ESP_TASK_WDT_TIMEOUT_S=60

# --- SCCB I2C Driver — dùng Legacy driver (ổn định với OV3660) ---
# New I2C driver (sccb-ng.c) có bug busy-wait vô hạn trong i2c_ll_is_bus_busy
CONFIG_SCCB_HARDWARE_I2C_DRIVER_LEGACY=y
# CONFIG_SCCB_HARDWARE_I2C_DRIVER_NEW is not set

# Disable Idle task WDT to pass the long camera init wait time
# CONFIG_ESP_TASK_WDT_CHECK_IDLE_TASK_CPU0 is not set
# CONFIG_ESP_TASK_WDT_CHECK_IDLE_TASK_CPU1 is not set

# --- Log Level ---
CONFIG_LOG_DEFAULT_LEVEL_INFO=y
```
